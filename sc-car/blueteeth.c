/*-----------------------------------------------
  名称：蓝牙调用函数库
  编写：夏杰
  日期：2017.4.24
  内容：蓝牙模块相关控制函数
------------------------------------------------*/
#include "sc.h"

// 定义接收的数据
uchar rec_data = 0;


/*-----------------------------------------------
  TODO：蓝牙模块初始化
  参数：
  编写：夏杰
  日期：2017.4.24
------------------------------------------------*/
void blueteeth_init()
{
//	SCON = 0x50;		//8位数据,可变波特率
//	TMOD |= 0x20;		//设定定时器1为8位自动重装方式
//	TL1 = 0xFD;		//设定定时初值
//	TH1 = 0xFD;		//设定定时器重装值
//	ET1 = 0;		//禁止定时器1中断
//	TR1 = 1;		//启动定时器1
//	ES = 1;

	SCON  = 0x50;		        // SCON: 模式 1, 8-bit UART, 使能接收  
    TMOD |= 0x20;               // TMOD: timer 1, mode 2, 8-bit 重装
    TH1 = 0xFD;               // TH1:  重装值 9600 波特率 晶振 11.0592MHz  
    TR1 = 0xFD;                  // TR1:  timer 1 打开                         
    ET1 = 0;                  //打开总中断
   	ES  = 1;                  //打开串口中断
}

/*-----------------------------------------------
  TODO：串口发送数据到蓝牙模块
  参数：dat 要发送的数据
  编写：夏杰
  日期：2017.4.24
------------------------------------------------*/
void blueteeth_send_byte(uchar dat)
{
	SBUF = dat;
	while(!TI);
	TI = 0;
}

/*-----------------------------------------------
  TODO：蓝牙发送字符串
  参数：*s 字符串首地址
  编写：夏杰
  日期：2017.4.24
------------------------------------------------*/
void blueteeth_send_str(uchar *s)
{
	while(*s != '\0')		// \0 表示字符串结束标志，通过检测是否字符串末尾
	{
		blueteeth_send_byte(*s);
		s++;
	}
}

/*-----------------------------------------------
  TODO：串口中断程序
  参数：null
  编写：夏杰
  日期：2017.4.24
------------------------------------------------*/
void UART_SER (void) interrupt 4	//串行中断服务程序
{   
	if( RI )						//判断是接收中断产生
	{
		RI = 0;						//标志位清零
		rec_data = SBUF;			//读入缓冲区的值
	}	
} 













